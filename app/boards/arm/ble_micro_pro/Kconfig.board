## app/boards/arm/ble_micro_pro/Kconfig.board
```kconfig
# BLE Micro Pro board configuration

# Copyright (c) 2021 The ZMK Contributors
# SPDX-License-Identifier: MIT

config BOARD_BLE_MICRO_PRO
	bool "BLE Micro Pro"
	depends on SOC_NRF52840_QIAA
```
